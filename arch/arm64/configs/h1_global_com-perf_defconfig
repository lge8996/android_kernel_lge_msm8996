## drivers/input/fingerprint/Kconfig
```kconfig
#
# Fingerprint drivers configuration
#

source "drivers/input/fingerprint/canvasbio/Kconfig"
source "drivers/input/fingerprint/et523/Kconfig"
```

## drivers/input/fingerprint/canvasbio/Kconfig
```kconfig
#
# Input device configuration
#

if INPUT_FINGERPRINT

config CANVASBIO_FINGERPRINT
    tristate "Canvasbio fp platform device"
	depends on SPI_MASTER
    help
      If say Y here to use CanvasBio fingerprint driver.

      If unsure, say N.

config CANVASBIO_FINGERPRINT_NAVIGATION
    tristate "Canvasbio fp navigation device"
	depends on CANVASBIO_FINGERPRINT
    default y
    help
      If say Y here, you can use fingerprint navigation.

endif
```

## drivers/input/fingerprint/et523/Kconfig
```kconfig
#
# Input device configuration
#

if INPUT_FINGERPRINT

config EGISTEC_FINGERPRINT
    tristate "Egistec fp platform device"
	depends on SPI_MASTER
    default n
    help
      If say Y here to use Egistec fingerprint driver.

      If unsure, say N.

endif
```

## drivers/input/touchscreen/lge/focaltech/Kconfig
```kconfig
#
# LGE touch core configuration
#
if INPUT_TOUCHSCREEN

source "drivers/input/touchscreen/lge/focaltech/ft5726/Kconfig"
endif
```

## drivers/input/touchscreen/lge/focaltech/ft5726/Kconfig
```kconfig
#
# LGE touch core configuration
#
if INPUT_TOUCHSCREEN

menuconfig LGE_TOUCH_FOCALTECH_FT5726
	bool "LGE Touch Core ODM Device Driver - FT5726"
	depends on LGE_TOUCH_CORE_BASE
	help
	  If your device is ft5726, say Y
# To Do : Focal Tech Chipseet

#source "drivers/input/touchscreen/lge/focaltech/ft5726/fts/Kconfig"

endif
```

## drivers/power/supply/lge/Kconfig
```kconfig
config LGE_PM_VENEER_PSY
	bool "Apply LGE veneer psy"
	depends on LGE_PM
	default n
	help
	  Say Y here enable support lge veneer psy

config LGE_PM_CCD
	bool "support Charging Control Daemon"
	depends on LGE_PM
	default n
	help
	  Say Y to using Charging Control Daemon(CCD)

config LGE_PM_BRINGUP
	bool "support LGE PM Bringup"
	depends on LGE_PM
	default n
	help
	  Say Y to using LGE PM Bringup

config LGE_PM_BATTID_REDETECTION
	bool "Apply battery id re-detection"
	depends on LGE_PM_VENEER_PSY
	default n
	help
	  Say Y here enable support battery re-detection
```

## drivers/soc/qcom/lge/Kconfig
```kconfig
config MACH_LGE
	bool "Machine LGE"
	help
	  Support for machine LGE.


menu "LGE Board Selection"

config MACH_MSM8996_TF10
        bool "MSM8996 TF10"
        depends on ARCH_MSM8996
        select MACH_LGE
        select LGE_DDR_SECTION_SIZE_CHANGE
        select LGE_MSM8996_ISB_WA
        select LGE_MSM8996_NOP_WA
        select LGE_MSM8996_FLUSH_WA
        select LGE_POWER_ONOFF_LOCKUP_DEBUG
        select LGE_DM_VERITY_RECOVERY
        help
          Support for the Qualcomm MSM8996 TF10 device.

config MACH_MSM8996_TF10_KR
        bool "MSM8996 TF10_KR"
        depends on ARCH_MSM8996
        select MACH_LGE
        help
          Support for the Qualcomm MSM8996 TF10_KR device.

config MACH_MSM8996_TF10_LAO_COM
        bool "MSM8996 TF10_LAO_COM"
        depends on ARCH_MSM8996
        select MACH_LGE
        help
          Support for the Qualcomm MSM8996 TF10_LAO_COM device.

config LGE_TARGET_DEVICE
	string  "Target Device Name"
	depends on MACH_LGE

config LGE_TARGET_PRODUCT
	string "Target Product Name"
	depends on MACH_LGE
endmenu


menu "LGE Specific Patches"

config LGE_HANDLE_PANIC
	tristate "Support LGE Crash Handler"
	default n
	depends on MACH_LGE
	help
	  LGE Crash Handler

config LGE_MSM8996_ISB_WA
	bool "Support ISB workaround for prevent MSM8996 timing issue"
	default n
	depends on MACH_MSM8996_LUCYE || MACH_MSM8996_FALCON || MACH_MSM8996_TF10
	help
		MSM8996 has timing issue sometimes.
		This feature prevents timing issue as inserting isb().

config LGE_MSM8996_NOP_WA
	bool "Support NOP workaround for prevent MSM8996 timing issue"
	default n
	depends on MACH_MSM8996_LUCYE || MACH_MSM8996_FALCON || MACH_MSM8996_TF10
	help
		MSM8996 has timing issue sometimes.
		This feature prevents timing issue as inserting nop().

config LGE_MSM8996_FLUSH_WA
	bool "Support flush workaround for prevent MSM8996 timing issue"
	default n
	depends on MACH_MSM8996_LUCYE || MACH_MSM8996_FALCON || MACH_MSM8996_TF10
	help
		MSM8996 has timing issue sometimes.
		This feature prevents timing issue as inserting flush.

config LGE_BOOT_LOCKUP_DETECT
	bool "Support to detect lockup during powering on"
	default n
	depends on LGE_HANDLE_PANIC
	help
	  For detecting lockup in boot , use simple detector which
	  raise crash when expired some period after boot.

config LGE_REBOOT_LOCKUP_DETECT
	bool "Support to detect lockup during powering off"
	default n
	depends on LGE_HANDLE_PANIC
	help
	  For detecting lockup in reboot or shutdown, use simple
	  detector which raise crash when expired some period after
	  reboot like system call.

config LGE_POWER_ONOFF_LOCKUP_DEBUG
	bool "Support to debug lockup during powering off"
	default n
	depends on LGE_HANDLE_PANIC
	help
	  For debugging lockup in reboot or shutdown, use simple
	  detector which raise crash when expired some period after
	  reboot like system call.


config LGE_BOOTLOADER_LOG
	tristate "Support LGE bootloader log"
	default n
	depends on MACH_LGE
	help
	  LGE bootloader log

config LGE_EARJACK_DEBUGGER
	bool "Earjack UART debugger support"
	default n
	depends on MACH_LGE
	help
	  Support earjack type UART debugger cable

config LGE_USB_DEBUGGER
	bool "USB UART debugger support"
	default n
	depends on LGE_PM_LGE_POWER_CLASS_CABLE_DETECT
	help
	  Support USB type UART debugger cable

config LGE_BOOTLOADER_TIME_CHECKER
    tristate "Supprt bootloader(LK, SBL) time"
    default n
    depends on MACH_LGE
    help
      Check LK, SBL booting time at
      sys/module/lge_bootloader_time_checker/parameters/lk_time
      sys/module/lge_bootloader_time_checker/parameters/sbl_time

config LGE_PM_DEBUG
        tristate "Support LGE PM Debug Feature"
        default n
        depends on MACH_LGE
        help
	  LGE PM Debug Feature

config LGE_PM_CABLE_DETECTION
	tristate "Support LGE PM Cable Detection"
	default n
	depends on MACH_LGE
	help
	  LGE PM Cable Detection

config LGE_PM_SMPL_COUNTER
	tristate "Support LGE SMPL COUNTER feature"
	default n
	depends on MACH_LGE
	help
	  Say y to enable smpl_cnt module, that count when
	  booted by SMPL

config LGE_PM_CHARGING_CONTROLLER
	tristate "LGE Charging controller"
	default n
	depends on MACH_LGE
	help
	  enable the LGE Charging controller

config LGE_PM_CHARGING_SCENARIO
	tristate "Support LGE PM Charging Scenario"
	default n
	depends on MACH_LGE
	help
	  LGE PM Charging Scenario

config LGE_PM_UNIFIED_NODE
	bool "enable LGE PM Unified sysfs node"
	default n
	depends on MACH_LGE
	help
	  Support LGE PM Unified sysfs node

config LGE_PM_PSEUDO_BATTERY
	tristate "Support pseudo battery mode"
	depends on MACH_LGE
	default n
	help
	  Say Y here to enable pseudo mode setting

config LGE_DEFAULT_HARD_RESET
	bool "LGE default hard reset"
	default n
	depends on MACH_LGE
	help
		This make hard reset when rebooting. reboot reason is
		deliveried by QPNP_PON_SOFT_RB_SPARE[2:7] register.

config LGE_ACC_NT
	tristate "Support NT accessory"
	depends on MACH_LGE
	default n
	help
	  Say Y here to enable pseudo mode setting

config PRE_SELF_DIAGNOSIS
	tristate "Support LGE self diagnosis for factory"
	default n
	depends on MACH_LGE
	help
	  LGE self diagnosis

config LGE_PANEL_MAKER_ID_SUPPORT
	tristate "Support pseudo battery mode"
	depends on MACH_LGE
	default n
	help
	  Say Y here to enable Panel Maker ID feature setting

config LGE_QSDL_SUPPORT
	tristate "Support for Quality Statistics Data Logging"
	default n
	depends on MACH_LGE
	help
	  QSDL is a feature which notify infomation for quality statistics
	  data logging of device.

config LGE_DM_VERITY_RECOVERY
	tristate "Support dm verity corrupt recovery"
	default n
	depends on MACH_LGE
	help
	  Sometimes, dm-bufio has invalid data. If data is corrupted,
	  try to recover data.

config LGE_PKM
    tristate "Support PKM driver with QSEE"
	depends on MACH_LGE
	default n
	help
	   Say Y here to enable Periodic Kernel Monitoring driver for LG IMA

config LGE_PM_DEBUG
        tristate "Support LGE PM Debug Feature"
        default n
        depends on MACH_LGE
        help
          LGE PM Debug Feature
endmenu

menu "LGE QFPROM Values"

config LGE_QFPROM_INTERFACE
	bool "Support qfprom interface"
	default n
	depends on MACH_LGE
	help
	  LGE QFPROM DRIVER.
endmenu

source "drivers/soc/qcom/lge/power/Kconfig"
source "drivers/soc/qcom/lge/hpue/Kconfig"
```

## drivers/soc/qcom/lge/hpue/Kconfig
```kconfig
menu "Boost IC driver for supporting HPUE"

config HPUE_DETECT
        bool "CONFIG_HPUE_DETECT"
        default n
	help
	  This is option enabling Boost IC driver for supporting HPUE
	  on TMUS, MPCS, and Sprint operators.

endmenu
```

## drivers/usb/pd/Kconfig
```kconfig
#
# USB Power Delivery driver configuration
#
menu "USB Power Delivery"

config USB_PD
	def_bool n

config USB_PD_POLICY
	tristate "USB Power Delivery Protocol and Policy Engine"
	depends on EXTCON
	depends on DUAL_ROLE_USB_INTF
	select USB_PD
	help
          Say Y here to enable USB PD protocol and policy engine.

config QPNP_USB_PDPHY
	tristate "QPNP USB Power Delivery PHY"
	depends on SPMI
	help
          Say Y here to enable QPNP USB PD PHY peripheral driver
	  which communicates over the SPMI bus. The is used to handle
	  the PHY layer communication of the Power Delivery stack.

config TCPC_CLASS
	bool "TypeC Port Controller Device Class"
	help
	  Say Y to enable
	  Typec Port
	  Controller Device
	  Class

config USB_POWER_DELIVERY
	bool "Support USB power delivery Function"
	default n
	help
	  Say Y to enable
	  USB
	  Power Delivery
	  support

config TCPC_RT1711
	bool "Richtek RT1711 TypeC port Controller Driver"
	depends on TCPC_CLASS
	default n
	help
	  Say Y to enable
	  Richtek RT1711
	  TypeC port Controller
	  Driver

config TCPC_RT1711H
	bool "Richtek RT1711H TypeC port Controller Driver"
	depends on TCPC_CLASS
	default n
	help
	  Say Y to enable
	  Richtek RT1711H
	  TypeC port Controller
	  Driver

config USB_PD_VBUS_STABLE_TOUT
	int "PD VBUS Stable Timeout"
	depends on USB_POWER_DELIVERY
	range 0 1000                       # >= 0,  <= 1000
	default 125
	help
          Setup a timeout value (ms)
	  for
	  VBUS change
	  stable

config USB_PD_VBUS_PRESENT_TOUT
	int "PD VBUS Present Timeout"
	depends on USB_POWER_DELIVERY
	range 0 1000                       # >= 0,  <= 1000
	default 20
	help
          Setup a timeout value (ms)
	  for
	  VBUS present
	  stable

endmenu
```

## sound/soc/codecs/tas2560/Kconfig
```kconfig
menuconfig SND_SOC_TAS2560_STEREO
	tristate "Texas Instruments TAS2560 SmartAmp(R)"

if SND_SOC_TAS2560_STEREO
config TAS2560_REGMAP_STEREO
    bool "Use of RegMap API"

config TAS2560_CODEC_STEREO
    bool "Codec Driver support"

config TAS2560_MISC_STEREO
    bool "Misc Driver support"

endif # SND_SOC_TAS2560_STEREO
```
