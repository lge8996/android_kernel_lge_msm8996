/* Copyright (c) 2014, The Linux Foundation. All rights reserved.
*
* This program is free software; you can redistribute it and/or modify
* it under the terms of the GNU General Public License version 2 and
* only version 2 as published by the Free Software Foundation.
*
* This program is distributed in the hope that it will be useful,
* but WITHOUT ANY WARRANTY; without even the implied warranty of
* MERCHANTABILITY or FITNESS FOR A PARTICULAR PURPOSE.  See the
* GNU General Public License for more details.
*/

&i2c_12{    /* BLSP-2 QUP6 */

	focaltech_ref_ft5726@38 {
		status = "disabled";
		compatible = "focaltech,fts";
		reg = <0x38>;
		interrupt-parent = <&tlmm>;
		interrupts = <125 0x2002>;
		focaltech,reset-gpio = <&tlmm 89 0x00>;
		focaltech,irq-gpio = <&tlmm 125 0x2002>;
		focaltech,vdd-gpio = <&tlmm 11 0x00>;
		focaltech,vio-gpio = <&tlmm 73 0x00>;

		focaltech,max-touch-number = <10>;
		focaltech,display-coords = <0 0 1200 1920>;

		pinctrl-names = "touch_int_active","touch_int_suspend","touch_release";

		pinctrl-0 = <&ts_int_active &ts_reset_active>;
		pinctrl-1 = <&ts_int_suspend &ts_reset_suspend>;
		pinctrl-2 = <&ts_release>;
	};

	focaltech,ft5726@38 {
		compatible = "focaltech,ft5726";
		status = "ok";

		reg = <0x38>;
		interrupt-parent = <&tlmm>;
		interrupts = <125 0x2002>;
		irqflags = <0x2002>;

		reset-gpio = <&tlmm 89 0x00>;
		irq-gpio = <&tlmm 125 0x2002>;
		vdd-gpio = <&tlmm 11 0x00>;	/* 2.8v - VDD */
		vio-gpio = <&tlmm 73 0x00>;	/* 1.8v - IOVCC */

		/* IRQF_ONESHOT		0x00002000 */
		/* IRQF_TRIGGER_FALLING		0x00000002 */
		/* IRQF_NO_SUSPEND		0x00004000 */

		pinctrl-names = "touch_pin_active", "touch_pin_sleep";	/* Touch GPIO pin name setting */
		pinctrl-0 = <&ts_int_active &ts_reset_active>;			/* Touch GPIO pin active setting */
		pinctrl-1 = <&ts_int_suspend &ts_reset_suspend>;		/* Touch GPIO pin suspend setting */

		/*Caps*/
		max_x = <1200>;
		max_y = <1920>;
		max_pressure = <0xff>;
		max_width_major = <15>;
		max_width_minor = <15>;
		max_orientation = <1>;
		max_id = <10>;
		sw_reset_delay = <200>;
		hw_reset_delay = <200>;

		/* Role */
		use_lpwg = <1>;
		use_lpwg_test = <1>;
		hide_coordinate = <1>;

		/* firmware & panel_spec path */
		use_fw_upgrade = <1>;

		fw_image = "touch/tf10/FT5726_Pramboot_V0.3_20141015.img",
				"touch/tf10/LGE_TF10_FT5726_Ver1.02_0x82_20190726_all.img";

		panel_spec = "touch/tf10/tf10_limit.txt";
		panel_spec_mfts_folder = "touch/tf10/tf10_limit_mfts.txt";

		/* Performance Test */
		use_perf_test = <1>;
		test_delay = <16>;
		test_pressure = <50>;
		test_width = <100>;
		test_jig_size = <8>;
		click_test_x = <90>;
		click_test_y = <410>;
		v_drag_test_x = <72>;
		v_drag_test_start_y = <971>;
		v_drag_test_end_y = <548>;
		h_drag_test_start_x = <571>;
		h_drag_test_end_x = <148>;
		h_drag_test_y = <1064>;
	};
};
