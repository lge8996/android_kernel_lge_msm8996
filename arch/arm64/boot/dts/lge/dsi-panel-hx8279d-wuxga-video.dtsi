/* Copyright (c) 2018, Code Aurora Forum. All rights reserved.
 *
 * This program is free software; you can redistribute it and/or modify
 * it under the terms of the GNU General Public License version 2 and
 * only version 2 as published by the Free Software Foundation.
 *
 * This program is distributed in the hope that it will be useful,
 * but WITHOUT ANY WARRANTY; without even the implied warranty of
 * MERCHANTABILITY or FITNESS FOR A PARTICULAR PURPOSE.  See the
 * GNU General Public License for more details.
 */

&mdss_mdp {
	dsi_hx8279d_wuxga_video: qcom,mdss_dsi_hx8279d_wuxga_video {
		qcom,mdss-dsi-panel-name = "hx8279d wuxga video mode dsi panel";
		qcom,mdss-dsi-panel-type = "dsi_video_mode";
		qcom,mdss-dsi-panel-controller = <&mdss_dsi0>;
		qcom,mdss-dsi-panel-framerate = <60>;
		qcom,mdss-dsi-virtual-channel-id = <0>;
		qcom,mdss-dsi-stream = <0>;
		qcom,mdss-dsi-panel-width = <1200>;
		qcom,mdss-dsi-panel-height = <1920>;
		qcom,mdss-dsi-h-front-porch = <20>;
		qcom,mdss-dsi-h-back-porch = <50>;
		qcom,mdss-dsi-h-pulse-width = <10>;
		qcom,mdss-dsi-h-sync-skew = <0>;
		qcom,mdss-dsi-v-back-porch = <15>;
		qcom,mdss-dsi-v-front-porch = <14>;
		qcom,mdss-dsi-v-pulse-width = <4>;
		qcom,mdss-dsi-h-left-border = <0>;
		qcom,mdss-dsi-h-right-border = <0>;
		qcom,mdss-dsi-v-top-border = <0>;
		qcom,mdss-dsi-v-bottom-border = <0>;
		qcom,mdss-pan-physical-width-dimension = <138>;
		qcom,mdss-pan-physical-height-dimension = <220>;
		qcom,mdss-dsi-bpp = <24>;
		qcom,mdss-dsi-color-order = "rgb_swap_rgb";
		qcom,mdss-dsi-underflow-color = <0xff>;
		qcom,mdss-dsi-border-color = <0>;

		qcom,mdss-dsi-on-command = [
			29 01 00 00 01 00 14 F4 FF FF FF 04 00 C0 F0 01 00 00 00 00 00 C0 F0 39 C1 01 02
			29 01 00 00 0A 00 14 F4 FF FF FF 68 00 00 F0 02 00 00 00 68 00 00 F0 00 00 00 00
			15 00 00 00 00 00 02 B0 00
			15 00 00 00 00 00 02 C2 0D
			15 00 00 00 00 00 02 C3 04
			15 00 00 00 00 00 02 C4 08
			15 00 00 00 00 00 02 C5 08
			15 00 00 00 00 00 02 BF 04
			15 00 00 00 00 00 02 C0 00
			15 00 00 00 00 00 02 B6 03 //add
			15 00 00 00 00 00 02 B0 02
			15 00 00 00 00 00 02 C0 00
			15 00 00 00 00 00 02 C1 11
			15 00 00 00 00 00 02 C2 19
			15 00 00 00 00 00 02 C3 29
			15 00 00 00 00 00 02 C4 34
			15 00 00 00 00 00 02 C5 35
			15 00 00 00 00 00 02 C6 35
			15 00 00 00 00 00 02 C7 34
			15 00 00 00 00 00 02 C8 2C
			15 00 00 00 00 00 02 C9 22
			15 00 00 00 00 00 02 CA 1D
			15 00 00 00 00 00 02 CB 1B
			15 00 00 00 00 00 02 CC 1C
			15 00 00 00 00 00 02 CD 1F
			15 00 00 00 00 00 02 CE 21
			15 00 00 00 00 00 02 CF 25
			15 00 00 00 00 00 02 D0 05
			15 00 00 00 00 00 02 D2 07
			15 00 00 00 00 00 02 D3 05
			15 00 00 00 00 00 02 D4 0F
			15 00 00 00 00 00 02 D5 21
			15 00 00 00 00 00 02 D6 27
			15 00 00 00 00 00 02 D7 2C
			15 00 00 00 00 00 02 D8 2E
			15 00 00 00 00 00 02 D9 30
			15 00 00 00 00 00 02 DA 2E
			15 00 00 00 00 00 02 DB 28
			15 00 00 00 00 00 02 DC 27
			15 00 00 00 00 00 02 DD 28
			15 00 00 00 00 00 02 DE 2D
			15 00 00 00 00 00 02 DF 2A
			15 00 00 00 00 00 02 E0 2D
			15 00 00 00 00 00 02 E1 2D
			15 00 00 00 00 00 02 E2 02
			15 00 00 00 00 00 02 B0 07   //DGC start
			15 00 00 00 00 00 02 B1 00
			15 00 00 00 00 00 02 B2 02
			15 00 00 00 00 00 02 B3 0A
			15 00 00 00 00 00 02 B4 1B
			15 00 00 00 00 00 02 B5 2B
			15 00 00 00 00 00 02 B6 39
			15 00 00 00 00 00 02 B7 5A
			15 00 00 00 00 00 02 B8 79
			15 00 00 00 00 00 02 B9 B9
			15 00 00 00 00 00 02 BA F8
			15 00 00 00 00 00 02 BB 72
			15 00 00 00 00 00 02 BC EF
			15 00 00 00 00 00 02 BD F3
			15 00 00 00 00 00 02 BE 6E
			15 00 00 00 00 00 02 BF ED
			15 00 00 00 00 00 02 C0 2E
			15 00 00 00 00 00 02 C1 6D
			15 00 00 00 00 00 02 C2 8D
			15 00 00 00 00 00 02 C3 AB
			15 00 00 00 00 00 02 C4 BB
			15 00 00 00 00 00 02 C5 CB
			15 00 00 00 00 00 02 C6 DB
			15 00 00 00 00 00 02 C7 E3
			15 00 00 00 00 00 02 C8 E8
			15 00 00 00 00 00 02 C9 00
			15 00 00 00 00 00 02 CA 00
			15 00 00 00 00 00 02 CB 05
			15 00 00 00 00 00 02 CC 6B
			15 00 00 00 00 00 02 CD FF
			15 00 00 00 00 00 02 CE FF
			15 00 00 00 00 00 02 B0 0A
			15 00 00 00 00 00 02 B1 00
			15 00 00 00 00 00 02 B2 02
			15 00 00 00 00 00 02 B3 0A
			15 00 00 00 00 00 02 B4 1B
			15 00 00 00 00 00 02 B5 2B
			15 00 00 00 00 00 02 B6 39
			15 00 00 00 00 00 02 B7 5A
			15 00 00 00 00 00 02 B8 79
			15 00 00 00 00 00 02 B9 B9
			15 00 00 00 00 00 02 BA F8
			15 00 00 00 00 00 02 BB 72
			15 00 00 00 00 00 02 BC EF
			15 00 00 00 00 00 02 BD F3
			15 00 00 00 00 00 02 BE 6E
			15 00 00 00 00 00 02 BF ED
			15 00 00 00 00 00 02 C0 2E
			15 00 00 00 00 00 02 C1 6D
			15 00 00 00 00 00 02 C2 8D
			15 00 00 00 00 00 02 C3 AB
			15 00 00 00 00 00 02 C4 BB
			15 00 00 00 00 00 02 C5 CB
			15 00 00 00 00 00 02 C6 DB
			15 00 00 00 00 00 02 C7 E3
			15 00 00 00 00 00 02 C8 E8
			15 00 00 00 00 00 02 C9 00
			15 00 00 00 00 00 02 CA 00
			15 00 00 00 00 00 02 CB 05
			15 00 00 00 00 00 02 CC 6B
			15 00 00 00 00 00 02 CD FF
			15 00 00 00 00 00 02 CE FF
			15 00 00 00 00 00 02 B0 08
			15 00 00 00 00 00 02 B1 00
			15 00 00 00 00 00 02 B2 03
			15 00 00 00 00 00 02 B3 0A
			15 00 00 00 00 00 02 B4 1A
			15 00 00 00 00 00 02 B5 29
			15 00 00 00 00 00 02 B6 37
			15 00 00 00 00 00 02 B7 57
			15 00 00 00 00 00 02 B8 74
			15 00 00 00 00 00 02 B9 B2
			15 00 00 00 00 00 02 BA EF
			15 00 00 00 00 00 02 BB 64
			15 00 00 00 00 00 02 BC DB
			15 00 00 00 00 00 02 BD E0
			15 00 00 00 00 00 02 BE 58
			15 00 00 00 00 00 02 BF D4
			15 00 00 00 00 00 02 C0 14
			15 00 00 00 00 00 02 C1 53
			15 00 00 00 00 00 02 C2 72
			15 00 00 00 00 00 02 C3 90
			15 00 00 00 00 00 02 C4 A0
			15 00 00 00 00 00 02 C5 AF
			15 00 00 00 00 00 02 C6 C0
			15 00 00 00 00 00 02 C7 C7
			15 00 00 00 00 00 02 C8 CC
			15 00 00 00 00 00 02 C9 00
			15 00 00 00 00 00 02 CA 00
			15 00 00 00 00 00 02 CB 05
			15 00 00 00 00 00 02 CC 6B
			15 00 00 00 00 00 02 CD FF
			15 00 00 00 00 00 02 CE FF
			15 00 00 00 00 00 02 B0 0B
			15 00 00 00 00 00 02 B1 00
			15 00 00 00 00 00 02 B2 03
			15 00 00 00 00 00 02 B3 0A
			15 00 00 00 00 00 02 B4 1A
			15 00 00 00 00 00 02 B5 29
			15 00 00 00 00 00 02 B6 37
			15 00 00 00 00 00 02 B7 57
			15 00 00 00 00 00 02 B8 74
			15 00 00 00 00 00 02 B9 B2
			15 00 00 00 00 00 02 BA EF
			15 00 00 00 00 00 02 BB 64
			15 00 00 00 00 00 02 BC DB
			15 00 00 00 00 00 02 BD E0
			15 00 00 00 00 00 02 BE 58
			15 00 00 00 00 00 02 BF D4
			15 00 00 00 00 00 02 C0 14
			15 00 00 00 00 00 02 C1 53
			15 00 00 00 00 00 02 C2 72
			15 00 00 00 00 00 02 C3 90
			15 00 00 00 00 00 02 C4 A0
			15 00 00 00 00 00 02 C5 AF
			15 00 00 00 00 00 02 C6 C0
			15 00 00 00 00 00 02 C7 C7
			15 00 00 00 00 00 02 C8 CC
			15 00 00 00 00 00 02 C9 00
			15 00 00 00 00 00 02 CA 00
			15 00 00 00 00 00 02 CB 05
			15 00 00 00 00 00 02 CC 6B
			15 00 00 00 00 00 02 CD FF
			15 00 00 00 00 00 02 CE FF
			15 00 00 00 00 00 02 B0 09
			15 00 00 00 00 00 02 B1 00
			15 00 00 00 00 00 02 B2 01
			15 00 00 00 00 00 02 B3 06
			15 00 00 00 00 00 02 B4 18
			15 00 00 00 00 00 02 B5 27
			15 00 00 00 00 00 02 B6 35
			15 00 00 00 00 00 02 B7 54
			15 00 00 00 00 00 02 B8 71
			15 00 00 00 00 00 02 B9 AC
			15 00 00 00 00 00 02 BA E7
			15 00 00 00 00 00 02 BB 59
			15 00 00 00 00 00 02 BC CC
			15 00 00 00 00 00 02 BD D0
			15 00 00 00 00 00 02 BE 45
			15 00 00 00 00 00 02 BF BC
			15 00 00 00 00 00 02 C0 F9
			15 00 00 00 00 00 02 C1 37
			15 00 00 00 00 00 02 C2 55
			15 00 00 00 00 00 02 C3 74
			15 00 00 00 00 00 02 C4 83
			15 00 00 00 00 00 02 C5 92
			15 00 00 00 00 00 02 C6 A1
			15 00 00 00 00 00 02 C7 A8
			15 00 00 00 00 00 02 C8 AC
			15 00 00 00 00 00 02 C9 00
			15 00 00 00 00 00 02 CA 00
			15 00 00 00 00 00 02 CB 05
			15 00 00 00 00 00 02 CC 6A
			15 00 00 00 00 00 02 CD FF
			15 00 00 00 00 00 02 CE FF
			15 00 00 00 00 00 02 B0 0C
			15 00 00 00 00 00 02 B1 00
			15 00 00 00 00 00 02 B2 01
			15 00 00 00 00 00 02 B3 06
			15 00 00 00 00 00 02 B4 18
			15 00 00 00 00 00 02 B5 27
			15 00 00 00 00 00 02 B6 35
			15 00 00 00 00 00 02 B7 54
			15 00 00 00 00 00 02 B8 71
			15 00 00 00 00 00 02 B9 AC
			15 00 00 00 00 00 02 BA E7
			15 00 00 00 00 00 02 BB 59
			15 00 00 00 00 00 02 BC CC
			15 00 00 00 00 00 02 BD D0
			15 00 00 00 00 00 02 BE 45
			15 00 00 00 00 00 02 BF BC
			15 00 00 00 00 00 02 C0 F9
			15 00 00 00 00 00 02 C1 37
			15 00 00 00 00 00 02 C2 55
			15 00 00 00 00 00 02 C3 74
			15 00 00 00 00 00 02 C4 83
			15 00 00 00 00 00 02 C5 92
			15 00 00 00 00 00 02 C6 A1
			15 00 00 00 00 00 02 C7 A8
			15 00 00 00 00 00 02 C8 AC
			15 00 00 00 00 00 02 C9 00
			15 00 00 00 00 00 02 CA 00
			15 00 00 00 00 00 02 CB 05
			15 00 00 00 00 00 02 CC 6A
			15 00 00 00 00 00 02 CD FF
			15 00 00 00 00 00 02 CE FF	//DGC end
			15 00 00 00 00 00 02 B0 01
			15 00 00 00 00 00 02 C0 08
			15 00 00 00 00 00 02 C1 08
			15 00 00 00 00 00 02 C2 07
			15 00 00 00 00 00 02 C3 07
			15 00 00 00 00 00 02 C4 06
			15 00 00 00 00 00 02 C5 06
			15 00 00 00 00 00 02 C6 05
			15 00 00 00 00 00 02 C7 05
			15 00 00 00 00 00 02 C8 24
			15 00 00 00 00 00 02 C9 24
			15 00 00 00 00 00 02 CA 0F
			15 00 00 00 00 00 02 CB 0F
			15 00 00 00 00 00 02 CC 00
			15 00 00 00 00 00 02 CD 00
			15 00 00 00 00 00 02 CE 26
			15 00 00 00 00 00 02 CF 26
			15 00 00 00 00 00 02 D0 0F
			15 00 00 00 00 00 02 D1 0F
			15 00 00 00 00 00 02 D2 01
			15 00 00 00 00 00 02 D3 01
			15 00 00 00 00 00 02 D4 08
			15 00 00 00 00 00 02 D5 08
			15 00 00 00 00 00 02 D6 07
			15 00 00 00 00 00 02 D7 07
			15 00 00 00 00 00 02 D8 06
			15 00 00 00 00 00 02 D9 06
			15 00 00 00 00 00 02 DA 05
			15 00 00 00 00 00 02 DB 05
			15 00 00 00 00 00 02 DC 24
			15 00 00 00 00 00 02 DD 24
			15 00 00 00 00 00 02 DE 0F
			15 00 00 00 00 00 02 DF 0F
			15 00 00 00 00 00 02 E0 00
			15 00 00 00 00 00 02 E1 00
			15 00 00 00 00 00 02 E2 26
			15 00 00 00 00 00 02 E3 26
			15 00 00 00 00 00 02 E4 0F
			15 00 00 00 00 00 02 E5 0F
			15 00 00 00 00 00 02 E6 01
			15 00 00 00 00 00 02 E7 01
			15 00 00 00 00 00 02 B0 06
			15 00 00 00 00 00 02 C0 A5
			15 00 00 00 00 00 02 D5 36
			15 00 00 00 00 00 02 B0 03
			15 00 00 00 00 00 02 BE 00
			15 00 00 00 00 00 02 C2 3E
			15 00 00 00 00 00 02 C3 3E
			15 00 00 00 00 00 02 C4 00
			15 00 00 00 00 00 02 C5 00
			15 00 00 00 00 00 02 C8 04
			15 00 00 00 00 00 02 C9 04
			15 00 00 00 00 00 02 CA 07
			15 00 00 00 00 00 02 CC 21
			15 00 00 00 00 00 02 CF 60
			15 00 00 00 00 00 02 D2 02
			15 00 00 00 00 00 02 D3 02
			15 00 00 00 00 00 02 D4 03
			15 00 00 00 00 00 02 D6 03
			15 00 00 00 00 00 02 DE 00
			15 00 00 00 00 00 02 DD 00
			15 00 00 00 00 00 02 E6 00
			15 00 00 00 00 00 02 E7 00
			15 00 00 00 00 00 02 B0 04
			15 00 00 00 00 00 02 C1 06
			15 00 00 00 00 00 02 C9 13
			15 00 00 00 00 00 02 CA 0E
			15 00 00 00 00 00 02 CB 14
			15 00 00 00 00 00 02 CC 14
			15 00 00 00 00 00 02 D6 78
			15 00 00 00 00 00 02 E9 08
			05 01 00 00 78 00 02 11 00
			15 00 00 00 00 00 02 B0 01
			15 00 00 00 00 00 02 C0 48
			15 00 00 00 00 00 02 C1 48
			15 00 00 00 00 00 02 C2 47
			15 00 00 00 00 00 02 C3 47
			15 00 00 00 00 00 02 C4 46
			15 00 00 00 00 00 02 C5 46
			15 00 00 00 00 00 02 C6 45
			15 00 00 00 00 00 02 C7 45
			15 00 00 00 00 00 02 C8 64
			15 00 00 00 00 00 02 C9 64
			15 00 00 00 00 00 02 CA 4F
			15 00 00 00 00 00 02 CB 4F
			15 00 00 00 00 00 02 CC 40
			15 00 00 00 00 00 02 CD 40
			15 00 00 00 00 00 02 CE 66
			15 00 00 00 00 00 02 CF 66
			15 00 00 00 00 00 02 D0 4F
			15 00 00 00 00 00 02 D1 4F
			15 00 00 00 00 00 02 D2 41
			15 00 00 00 00 00 02 D3 41
			15 00 00 00 00 00 02 D4 48
			15 00 00 00 00 00 02 D5 48
			15 00 00 00 00 00 02 D6 47
			15 00 00 00 00 00 02 D7 47
			15 00 00 00 00 00 02 D8 46
			15 00 00 00 00 00 02 D9 46
			15 00 00 00 00 00 02 DA 45
			15 00 00 00 00 00 02 DB 45
			15 00 00 00 00 00 02 DC 64
			15 00 00 00 00 00 02 DD 64
			15 00 00 00 00 00 02 DE 4F
			15 00 00 00 00 00 02 DF 4F
			15 00 00 00 00 00 02 E0 40
			15 00 00 00 00 00 02 E1 40
			15 00 00 00 00 00 02 E2 66
			15 00 00 00 00 00 02 E3 66
			15 00 00 00 00 00 02 E4 4F
			15 00 00 00 00 00 02 E5 4F
			15 00 00 00 00 00 02 E6 41
			15 00 00 00 00 00 02 E7 41
			05 01 00 00 14 00 02 29 00
		];

		qcom,mdss-dsi-off-command = [
			//05 01 00 00 14 00 02 28 00
			05 01 00 00 78 00 02 10 00
		];

		qcom,mdss-dsi-on-command-state = "dsi_lp_mode";
		qcom,mdss-dsi-off-command-state = "dsi_lp_mode";

		qcom,mdss-dsi-h-sync-pulse = <0>;
		qcom,mdss-dsi-traffic-mode = "non_burst_sync_event";
		qcom,mdss-dsi-lane-map = "lane_map_0123";
		qcom,mdss-dsi-bllp-eof-power-mode;
		qcom,mdss-dsi-bllp-power-mode;
		qcom,mdss-dsi-tx-eot-append;
		qcom,mdss-dsi-lane-0-state;
		qcom,mdss-dsi-lane-1-state;
		qcom,mdss-dsi-lane-2-state;
		qcom,mdss-dsi-lane-3-state;
		qcom,mdss-dsi-panel-timings-phy-v2 = [
			24 1F 08 09 05 02 04 a0
			24 1F 08 09 05 02 04 a0
			24 1F 08 09 05 02 04 a0
			24 1F 08 09 05 02 04 a0
			24 1B 08 09 05 02 04 a0
			];

		qcom,mdss-dsi-t-clk-post = <0x0d>;
		qcom,mdss-dsi-t-clk-pre = <0x30>;
		qcom,cont-splash-enabled;
		qcom,mdss-dsi-dma-trigger = "trigger_sw";
		qcom,mdss-dsi-mdp-trigger = "none";
		qcom,mdss-dsi-lp11-init;
		qcom,mdss-dsi-reset-sequence = <1 2>, <1 0>, <1 0>;
		qcom,mdss-dsi-iris-reset-sequence = <1 0>, <0 10>, <1 8>;

		qcom,mdss-dsi-panel-hdr-enabled;
		qcom,mdss-dsi-panel-hdr-color-primaries = <114880 15935 32435 16555 14945 30910 7790 3415>;
		qcom,mdss-dsi-panel-peak-brightness = <5643000>;
		qcom,mdss-dsi-panel-blackness-level = <6134>;

		lge,blmap = <
			0 30 30 30 30 30 30 30 30 30  /* 0 ~ 9 */
			30 31 32 33 35 36 37 39 40 41  /* 10 ~ 19 */
			43 44 45 47 48 49 51 52 54 55  /* 20 ~ 29 */
			56 58 59 61 62 64 65 66 67 68  /* 30 ~ 39 */
			70 71 72 73 74 76 77 78 79 81  /* 40 ~ 49 */
			86 92 98 103 109 115 120 126 132 138 /* 50 ~ 59 */
			141 145 149 152 156 160 164 167 171 175  /* 60 ~ 69 */
			178 182 186 190 196 203 209 216 222 229  /* 70 ~ 79 */
			235 242 248 255 261 268 274 280 286 292  /* 80 ~ 89 */
			299 305 311 317 324 330 336 342 349 362  /* 90 ~ 99 */
			376 389 403 417 430 444 458 471 485 499  /* 100 ~ 109 */
			511 524 537 549 562 575 587 600 613 625  /* 110 ~ 119 */
			638 651 664 677 691 705 719 733 747 760  /* 120 ~ 129 */
			774 788 802 816 830 845 860 875 890 905  /* 130 ~ 139 */
			920 935 950 965 980 995 1007 1020 1033 1046  /* 140 ~ 149 */
			1059 1072 1084 1097 1110 1123 1136 1149 1162 1182  /* 150 ~ 159 */
			1202 1222 1242 1262 1283 1303 1323 1343 1363 1383  /* 160 ~ 169 */
			1404 1421 1439 1456 1474 1492 1509 1527 1544 1562  /* 170 ~ 179 */
			1580 1597 1615 1633 1657 1682 1707 1732 1757 1782  /* 180 ~ 189 */
			1806 1831 1856 1881 1906 1931 1955 1980 2005 2030  /* 190 ~ 199 */
			2054 2079 2104 2129 2153 2178 2203 2228 2253 2279  /* 200 ~ 209 */
			2306 2333 2359 2386 2413 2440 2466 2493 2520 2547  /* 210 ~ 219 */
			2574 2602 2630 2657 2685 2713 2740 2768 2796 2823  /* 220 ~ 229 */
			2851 2879 2907 2937 2967 2997 3027 3057 3087 3117  /* 230 ~ 239 */
			3147 3177 3207 3237 3267 3299 3332 3365 3398 3431  /* 240 ~ 249 */
			3464 3497 3530 3563 3596 3629      /* 250 ~ 255 */
			>;
	};
};

