/* Copyright (c) 2015, The Linux Foundation. All rights reserved.
 *
 * This program is free software; you can redistribute it and/or modify
 * it under the terms of the GNU General Public License version 2 and
 * only version 2 as published by the Free Software Foundation.
 *
 * This program is distributed in the hope that it will be useful,
 * but WITHOUT ANY WARRANTY; without even the implied warranty of
 * MERCHANTABILITY or FITNESS FOR A PARTICULAR PURPOSE.  See the
 * GNU General Public License for more details.
 */

#include "../msm8996-tf10-usb-typec-rt1711h.dtsi"

&usb3 {
        extcon = <&pmi8994_charger>;
};

&usb2s {
	status = "disabled";
};

&qusb_phy0 {
	qcom,qusb-phy-tune = <0x08 0x03 0x81 0xC7 0x00>;
	qcom,qusb-phy-tune-host = <0xA8 0xA3 0x80 0xC7 0x00>;
};

/* huaqin FPCB v4 : tx-swing : 0x1f tx-de-emp : 0x1f */
&ssphy {
	qcom,tx-swing = <0x1f>;			/* 100% of Vcca 925mV */
	qcom,tx-de-emphasis = <0x1f>;	/* -11.3 db (Vde/Vpre = 27%) */
	/* qcom,rx-equalization = <0xdb>; /* hardware default ~3.5db */
};
