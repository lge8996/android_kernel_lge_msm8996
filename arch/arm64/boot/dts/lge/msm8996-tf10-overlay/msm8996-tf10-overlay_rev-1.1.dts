/* Copyright (c) 2015, The Linux Foundation. All rights reserved.
 *
 * This program is free software; you can redistribute it and/or modify
 * it under the terms of the GNU General Public License version 2 and
 * only version 2 as published by the Free Software Foundation.
 *
 * This program is distributed in the hope that it will be useful,
 * but WITHOUT ANY WARRANTY; without even the implied warranty of
 * MERCHANTABILITY or FITNESS FOR A PARTICULAR PURPOSE.  See the
 * GNU General Public License for more details.
 */


/dts-v1/;
/plugin/;

#include "msm8996-tf10.dtsi"
#include "../msm8996-tf10-touch-focaltech-ft5726.dtsi"
#include "../msm8996-sound/msm8996-tf10-sound_rev-a.dtsi"
#include "msm8996-tf10-usb_rev-1.1.dtsi"

/ {
	model = "Qualcomm Technologies, Inc. MSM 8996pro v1.1 + PMI8996 MTP";
	compatible = "qcom,msm8996-mtp", "qcom,msm8996", "qcom,mtp";
	qcom,board-id = <0xD08 0>;
};

